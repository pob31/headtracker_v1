## CMakeLists.txt
```
# SPDX-License-Identifier: GPL-3.0-or-later
# app_dongle — USB receiver dongle firmware (Seeed XIAO nRF52840 Sense).
# Build: west build -b xiao_ble/nrf52840/sense firmware/app_dongle
cmake_minimum_required(VERSION 3.20.0)

find_package(Zephyr REQUIRED HINTS $ENV{ZEPHYR_BASE})
project(app_dongle LANGUAGES C)

# Shared protocol/framing code. HTK_WITH_FUSION stays off: the dongle never
# runs fusion — raw-mode consumers do that host-side.
include(${CMAKE_CURRENT_SOURCE_DIR}/../common/common.cmake)

target_sources(app PRIVATE
  src/main.c
  src/leds.c
  src/usb_io.c
  src/radio.c
  src/trackers.c
  src/sim.c
)
```

## prj.conf
```kconfig
# SPDX-License-Identifier: GPL-3.0-or-later
# app_dongle — USB receiver dongle (XIAO nRF52840 Sense)

# --- Radio: Nordic ESB. ESB owns IRQ priorities 0-1; every other peripheral
# must sit at >= 2 (USBD is bumped in the boards/ overlay).
CONFIG_ESB=y
# Air payloads are <= 26 B; 32 is the ESB DPL cap (and the Kconfig default).
CONFIG_ESB_MAX_PAYLOAD_LENGTH=32

# --- USB: legacy device stack for v0.1.
# NOTE: migration to the new usbd stack (CONFIG_USB_DEVICE_STACK_NEXT) is
# planned; the legacy stack is used for now because it is proven alongside the
# ESB sample scaffolding (PRD risk 4). Revisit at M6.
CONFIG_USB_DEVICE_STACK=y
# The new stack defaults on somewhere upstream in NCS 3.3; both stacks enabled
# at once makes each claim the cdc-acm DT node (duplicate device definitions).
CONFIG_USB_DEVICE_STACK_NEXT=n
CONFIG_USB_CDC_ACM=y
CONFIG_USB_DEVICE_PRODUCT="headtracker dongle"

# CDC-ACM is driven through the interrupt-driven UART API + a TX frame ring.
CONFIG_SERIAL=y
CONFIG_UART_INTERRUPT_DRIVEN=y
CONFIG_RING_BUFFER=y

# LEDs
CONFIG_GPIO=y

# Simulator uses sinf/cosf; M4F hard-float.
CONFIG_FPU=y

# Logging: deferred so log processing never sits in the radio/USB data path.
CONFIG_LOG=y
CONFIG_LOG_MODE_DEFERRED=y
CONFIG_LOG_DEFAULT_LEVEL=3

CONFIG_MAIN_STACK_SIZE=2048
CONFIG_SYSTEM_WORKQUEUE_STACK_SIZE=2048
```

## boards/xiao_ble_nrf52840_sense.overlay
```dts
/* SPDX-License-Identifier: GPL-3.0-or-later
 *
 * app_dongle overlay for xiao_ble/nrf52840/sense.
 * - CDC-ACM instance on the native USB device (the dongle's host pipe).
 * - USBD interrupt priority moved out of ESB's reserved band.
 */

&zephyr_udc0 {
	cdc_acm_uart0: cdc_acm_uart0 {
		compatible = "zephyr,cdc-acm-uart";
	};
};

/* PRD risk 1: ESB owns interrupt priorities 0-1; the nRF52 devicetree default
 * puts USBD at priority 1, which corrupts radio reception under USB load.
 * Raise USBD to priority 2.
 * VERIFY on hardware: IRQ number 39 matches the usbd node in nrf52840.dtsi
 * (only the priority cell is intended to change); confirm no radio CRC errors
 * under sustained USB traffic. */
&usbd {
	interrupts = <39 2>;
};
```

## src/main.c
```c
/* SPDX-License-Identifier: GPL-3.0-or-later
 *
 * app_dongle: USB receiver dongle. Wiring only — the modules do the work:
 *   usb_io    CDC-ACM pipe, framing, host command dispatch
 *   radio     ESB PRX data path + presence beacons
 *   trackers  per-id stats table + 1 Hz STATUS/TRACKER_STAT emission
 *   sim       synthetic ORIENT stream (SIM_MODE)
 *
 * Streaming starts as soon as air packets arrive; no handshake or selection
 * is required (PROTOCOL.md §1.7). Beacons run whenever the dongle is
 * powered, which is what holds head units out of standby.
 */
#include <stdio.h>

#include <zephyr/kernel.h>
#include <zephyr/logging/log.h>

#include <htk_protocol.h>

#include "leds.h"
#include "usb_io.h"
#include "radio.h"
#include "trackers.h"

LOG_MODULE_REGISTER(main, CONFIG_LOG_DEFAULT_LEVEL);

/* 1 Hz: rate fold-over, eviction, STATUS + TRACKER_STAT emission.
 * Runs on the system workqueue (frame encoding doesn't belong in a timer
 * ISR); GET_STATS reuses the same emission from the usb_io work context. */
static void stats_work_fn(struct k_work *work)
{
	ARG_UNUSED(work);
	trackers_tick_1hz();

	/* Bring-up diagnostics: beacon outcome counters as a LOG frame, so the
	 * host can see radio health without a debug probe. Cheap enough to keep
	 * until the air link is proven, then demote to on-request. */
	struct radio_beacon_stats b;
	uint8_t log_payload[HTK_MAX_PAYLOAD];
	radio_get_beacon_stats(&b);
	int n = snprintf((char *)log_payload + 1, sizeof(log_payload) - 1,
			 "bcn a=%u s=%u sf=%u wf=%u to=%u pf=%u",
			 b.attempts, b.sent, b.setup_fail, b.write_fail,
			 b.tx_timeout, b.prx_fail);
	if (n > 0) {
		log_payload[0] = HTK_PKT_LOG;
		usb_io_send_payload(log_payload,
				    MIN((size_t)n + 1, sizeof(log_payload)));
	}
}
static K_WORK_DEFINE(stats_work, stats_work_fn);

static void stats_timer_fn(struct k_timer *timer)
{
	ARG_UNUSED(timer);
	k_work_submit(&stats_work);
}
static K_TIMER_DEFINE(stats_timer, stats_timer_fn, NULL);

/* Blue heartbeat while USB is configured; dark otherwise. */
static void heartbeat_timer_fn(struct k_timer *timer)
{
	ARG_UNUSED(timer);
	static bool on;

	on = usb_io_is_configured() && !on;
	leds_set_blue(on);
}
static K_TIMER_DEFINE(heartbeat_timer, heartbeat_timer_fn, NULL);

int main(void)
{
	int err = leds_init();

	if (err) {
		LOG_ERR("LED init failed (%d)", err);
	}

	err = usb_io_init();
	if (err) {
		LOG_ERR("USB init failed (%d)", err);
		leds_set_red(true);
	}

	err = radio_init();
	if (err) {
		LOG_ERR("radio init failed (%d)", err);
		leds_set_red(true);
	}

	k_timer_start(&stats_timer, K_SECONDS(1), K_SECONDS(1));
	k_timer_start(&heartbeat_timer, K_MSEC(500), K_MSEC(500));

	LOG_INF("headtracker dongle fw %u.%u.%u, proto %u",
		HTK_FW_MAJOR, HTK_FW_MINOR, HTK_FW_PATCH, HTK_PROTO_VERSION);
	return 0;
}
```

## src/leds.c
```c
/* SPDX-License-Identifier: GPL-3.0-or-later */
#include <zephyr/kernel.h>
#include <zephyr/drivers/gpio.h>
#include <zephyr/logging/log.h>

#include "leds.h"

LOG_MODULE_REGISTER(leds, CONFIG_LOG_DEFAULT_LEVEL);

/* xiao_ble aliases: led0 = red, led1 = green, led2 = blue (all active-low;
 * GPIO_ACTIVE_LOW comes from the board DT, so logical 1 = lit). */
static const struct gpio_dt_spec led_red   = GPIO_DT_SPEC_GET(DT_ALIAS(led0), gpios);
static const struct gpio_dt_spec led_green = GPIO_DT_SPEC_GET(DT_ALIAS(led1), gpios);
static const struct gpio_dt_spec led_blue  = GPIO_DT_SPEC_GET(DT_ALIAS(led2), gpios);

/* Green flicker: toggle every 16th packet (~13 Hz blink at 208 Hz traffic),
 * forced off 250 ms after traffic stops. */
#define ACTIVITY_DIV_MASK 0x0Fu
#define ACTIVITY_OFF_MS   250

static uint32_t activity_count;

static void activity_off_fn(struct k_work *work)
{
	ARG_UNUSED(work);
	gpio_pin_set_dt(&led_green, 0);
}
static K_WORK_DELAYABLE_DEFINE(activity_off_work, activity_off_fn);

int leds_init(void)
{
	const struct gpio_dt_spec *leds[] = { &led_red, &led_green, &led_blue };

	for (size_t i = 0; i < ARRAY_SIZE(leds); i++) {
		if (!gpio_is_ready_dt(leds[i])) {
			return -ENODEV;
		}
		int err = gpio_pin_configure_dt(leds[i], GPIO_OUTPUT_INACTIVE);

		if (err) {
			return err;
		}
	}
	return 0;
}

void leds_set_blue(bool on)
{
	gpio_pin_set_dt(&led_blue, on);
}

void leds_set_red(bool on)
{
	gpio_pin_set_dt(&led_red, on);
}

void leds_activity(void)
{
	if ((++activity_count & ACTIVITY_DIV_MASK) == 0) {
		gpio_pin_toggle_dt(&led_green);
		k_work_reschedule(&activity_off_work, K_MSEC(ACTIVITY_OFF_MS));
	}
}
```

## src/leds.h
```c
/* LED policy: blue = USB-configured heartbeat, green = air RX activity,
 * red = fatal init error. Board LEDs are active-low; the polarity lives in
 * the board devicetree, so all levels here are logical.
 * SPDX-License-Identifier: GPL-3.0-or-later */
#ifndef APP_LEDS_H
#define APP_LEDS_H

#include <stdbool.h>

int  leds_init(void);
void leds_set_blue(bool on);
void leds_set_red(bool on);

/* Call once per received air packet (thread context). Flickers green while
 * traffic flows; goes dark shortly after it stops. */
void leds_activity(void);

#endif
```

## src/radio.c
```c
/* SPDX-License-Identifier: GPL-3.0-or-later
 *
 * ESB broadcast fabric, dongle side (PROTOCOL.md Part 2).
 *
 * Normal state: PRX on the uplink address (pipe 0), receiving no-ack data
 * packets from every head unit in range. The ESB IRQ handler only copies
 * payloads into a message queue; a processing thread validates them, feeds
 * the tracker table, and forwards ORIENT/RAW verbatim to the USB pipe (air
 * payload bytes == USB payload bytes, §2.2).
 *
 * Every HTK_BEACON_PERIOD_MS the radio briefly flips to PTX on the downlink
 * address to emit one no-ack presence beacon, optionally carrying the pending
 * sensor-directed command, then returns to PRX. RX is deaf during that
 * window; at 2 Mbps the beacon itself is ~100 us on air, so the loss shows
 * up as a fraction of a percent in seq_lost at worst.
 */
#include <zephyr/kernel.h>
#include <zephyr/logging/log.h>
#include <zephyr/drivers/clock_control.h>
#include <zephyr/drivers/clock_control/nrf_clock_control.h>

#include <esb.h>
#include <string.h>

#include <htk_protocol.h>
#include <htk_radio.h>

#include "radio.h"
#include "trackers.h"
#include "usb_io.h"
#include "leds.h"

LOG_MODULE_REGISTER(radio, CONFIG_LOG_DEFAULT_LEVEL);

/* Largest embedded command payload is htk_set_rate (5 B). */
#define PENDING_CMD_MAX 8

static struct {
	uint8_t buf[PENDING_CMD_MAX];
	uint8_t len;
	uint8_t repeats_left; /* beacons still carrying this command */
} pending_cmd;
static struct k_spinlock pending_lock;

static uint8_t beacon_seq;
static uint32_t rx_queue_overruns;
static struct radio_beacon_stats bcn_stats;

static K_SEM_DEFINE(tx_done_sem, 0, 1);

/* ESB IRQ -> processing thread hand-off. 64 entries ~= 300 ms of one
 * tracker at 208 Hz; overruns are counted, not blocked on. */
struct radio_pkt {
	uint8_t len;
	uint8_t data[HTK_ESB_MAX_PAYLOAD];
};
K_MSGQ_DEFINE(rx_msgq, sizeof(struct radio_pkt), 64, 1);

/* Beacons run on a dedicated workqueue so a busy system workqueue can never
 * stretch the beacon period (head units time their listen windows on it). */
static struct k_work_q radio_wq;
static K_THREAD_STACK_DEFINE(radio_wq_stack, 1024);
#define RADIO_WQ_PRIO 2

/* ---- ESB event handler (radio IRQ context: copy out, nothing else) ------ */

static void on_esb_event(const struct esb_evt *event)
{
	switch (event->evt_id) {
	case ESB_EVENT_RX_RECEIVED: {
		struct esb_payload payload;

		while (esb_read_rx_payload(&payload) == 0) {
			struct radio_pkt pkt;

			pkt.len = payload.length;
			memcpy(pkt.data, payload.data, payload.length);
			if (k_msgq_put(&rx_msgq, &pkt, K_NO_WAIT) != 0) {
				rx_queue_overruns++;
			}
		}
		break;
	}
	case ESB_EVENT_TX_SUCCESS:
	case ESB_EVENT_TX_FAILED:
		/* no-ack TX never reports FAILED, but treat both as "done". */
		k_sem_give(&tx_done_sem);
		break;
	default:
		break;
	}
}

/* ---- mode (re)configuration --------------------------------------------- */

static int esb_setup(enum esb_mode mode)
{
	static const uint8_t base_addr[4] = HTK_ADDR_BASE;
	uint8_t prefix = (mode == ESB_MODE_PTX) ? HTK_PREFIX_DOWNLINK
						: HTK_PREFIX_UPLINK;
	struct esb_config config = ESB_DEFAULT_CONFIG;
	int err;

	config.protocol = ESB_PROTOCOL_ESB_DPL;
	config.mode = mode;
	config.event_handler = on_esb_event;
	config.bitrate = ESB_BITRATE_2MBPS;
	config.crc = ESB_CRC_16BIT;
	/* Honor per-packet noack in both directions; nothing on this fabric
	 * is ever ACKed (§2.1). Retransmit settings are moot under noack. */
	config.selective_auto_ack = true;

	err = esb_init(&config);
	if (err) {
		return err;
	}
	err = esb_set_base_address_0(base_addr);
	if (err) {
		return err;
	}
	err = esb_set_prefixes(&prefix, 1);
	if (err) {
		return err;
	}
	/* Only pipe 0 in use. VERIFY: NCS 3.3 esb_set_prefixes(len=1) leaves
	 * other pipes disabled; otherwise add esb_enable_pipes(BIT(0)). */
	return esb_set_rf_channel(HTK_RF_CHANNEL);
}

/* ---- beacon TX (radio workqueue) ---------------------------------------- */

static void beacon_work_fn(struct k_work *work)
{
	ARG_UNUSED(work);
	struct esb_payload tx;
	struct htk_beacon_hdr hdr = {
		.type = HTK_PKT_BEACON,
		.beacon_seq = beacon_seq++,
	};

	memset(&tx, 0, sizeof(tx));
	tx.pipe = 0;
	tx.noack = true;
	memcpy(tx.data, &hdr, sizeof(hdr));
	tx.length = sizeof(hdr);

	K_SPINLOCK(&pending_lock) {
		if (pending_cmd.repeats_left > 0) {
			memcpy(&tx.data[tx.length], pending_cmd.buf,
			       pending_cmd.len);
			tx.length += pending_cmd.len;
			pending_cmd.repeats_left--;
		}
	}

	/* PRX -> PTX -> PRX. RX is deaf for the whole switchover.
	 * VERIFY on hardware: measure the total gap (esb_disable + esb_init
	 * twice + ~100 us on air); expected well under 1 ms, i.e. <1% of the
	 * beacon period. If re-init proves too slow, cache the two configs or
	 * use radio shorts — measure first. */
	bcn_stats.attempts++;
	esb_stop_rx();
	esb_disable();

	if (esb_setup(ESB_MODE_PTX) == 0) {
		k_sem_reset(&tx_done_sem);
		/* ESB_TXMODE_AUTO (default config): writing the payload
		 * starts transmission; esb_start_tx() is only for manual
		 * mode. VERIFY against NCS 3.3 esb_ptx sample. */
		if (esb_write_payload(&tx) == 0) {
			if (k_sem_take(&tx_done_sem, K_MSEC(10)) != 0) {
				bcn_stats.tx_timeout++;
				LOG_WRN("beacon TX completion timeout");
			} else {
				bcn_stats.sent++;
			}
		} else {
			bcn_stats.write_fail++;
			LOG_WRN("beacon write failed");
		}
		esb_disable();
	} else {
		bcn_stats.setup_fail++;
	}

	int err = esb_setup(ESB_MODE_PRX);

	if (err == 0) {
		err = esb_start_rx();
	}
	if (err) {
		bcn_stats.prx_fail++;
		LOG_ERR("PRX restore failed (%d)", err);
		leds_set_red(true);
	}
}

void radio_get_beacon_stats(struct radio_beacon_stats *out)
{
	*out = bcn_stats; /* u32 snapshot races are harmless for diagnostics */
}
static K_WORK_DEFINE(beacon_work, beacon_work_fn);

static void beacon_timer_fn(struct k_timer *timer)
{
	ARG_UNUSED(timer);
	k_work_submit_to_queue(&radio_wq, &beacon_work);
}
static K_TIMER_DEFINE(beacon_timer, beacon_timer_fn, NULL);

/* ---- RX processing thread ----------------------------------------------- */

static void rx_thread_fn(void *a, void *b, void *c)
{
	ARG_UNUSED(a); ARG_UNUSED(b); ARG_UNUSED(c);
	struct radio_pkt pkt;

	for (;;) {
		k_msgq_get(&rx_msgq, &pkt, K_FOREVER);
		if (pkt.len < 1) {
			continue;
		}

		switch (pkt.data[0]) {
		case HTK_PKT_ORIENT:
			if (pkt.len != sizeof(struct htk_orient)) {
				break;
			}
			{
				const struct htk_orient *o =
					(const struct htk_orient *)pkt.data;
				trackers_on_sample(o->id, o->seq);
				/* Air payload == USB payload (§2.2): forward
				 * the bytes verbatim; usb_io adds CRC + COBS. */
				usb_io_send_payload(pkt.data, pkt.len);
				leds_activity();
			}
			break;

		case HTK_PKT_RAW:
			if (pkt.len != sizeof(struct htk_raw)) {
				break;
			}
			{
				const struct htk_raw *r =
					(const struct htk_raw *)pkt.data;
				trackers_on_sample(r->id, r->seq);
				usb_io_send_payload(pkt.data, pkt.len);
				leds_activity();
			}
			break;

		case HTK_PKT_TSTATUS:
			if (pkt.len != sizeof(struct htk_tstatus)) {
				break;
			}
			/* Air-only: merged into TRACKER_STAT bookkeeping,
			 * never forwarded to USB. */
			trackers_on_tstatus(
				(const struct htk_tstatus *)pkt.data);
			leds_activity();
			break;

		default:
			/* Unknown air type: ignore (forward compatibility). */
			break;
		}
	}
}
K_THREAD_DEFINE(radio_rx_tid, 1536, rx_thread_fn, NULL, NULL, NULL,
		K_PRIO_PREEMPT(5), 0, 0);

/* ---- init ---------------------------------------------------------------- */

/* HF crystal must run before esb_init (NCS esb samples' clocks_start()).
 * VERIFY: this is the NCS 3.3 / Zephyr 4.1 onoff pattern for nRF52; newer
 * SoCs use a different clock-control API. */
static int clocks_start(void)
{
	struct onoff_manager *clk_mgr;
	struct onoff_client clk_cli;
	int err;
	int res;

	clk_mgr = z_nrf_clock_control_get_onoff(CLOCK_CONTROL_NRF_SUBSYS_HF);
	if (clk_mgr == NULL) {
		return -ENODEV;
	}

	sys_notify_init_spinwait(&clk_cli.notify);
	err = onoff_request(clk_mgr, &clk_cli);
	if (err < 0) {
		return err;
	}

	do {
		err = sys_notify_fetch_result(&clk_cli.notify, &res);
	} while (err == -EAGAIN);

	if (err < 0) {
		return err;
	}
	return res;
}

void radio_set_pending_cmd(const uint8_t *payload, size_t len)
{
	if (len == 0 || len > PENDING_CMD_MAX ||
	    len > HTK_ESB_MAX_PAYLOAD - sizeof(struct htk_beacon_hdr)) {
		return;
	}

	K_SPINLOCK(&pending_lock) {
		/* Latest command wins (§2.3); repeats restart. */
		memcpy(pending_cmd.buf, payload, len);
		pending_cmd.len = (uint8_t)len;
		pending_cmd.repeats_left = HTK_BEACON_CMD_REPEATS;
	}
}

int radio_init(void)
{
	int err = clocks_start();

	if (err) {
		return err;
	}

	err = esb_setup(ESB_MODE_PRX);
	if (err) {
		return err;
	}
	err = esb_start_rx();
	if (err) {
		return err;
	}

	k_work_queue_start(&radio_wq, radio_wq_stack,
			   K_THREAD_STACK_SIZEOF(radio_wq_stack),
			   RADIO_WQ_PRIO, NULL);
	k_thread_name_set(&radio_wq.thread, "radio_wq");

	k_timer_start(&beacon_timer, K_MSEC(HTK_BEACON_PERIOD_MS),
		      K_MSEC(HTK_BEACON_PERIOD_MS));

	LOG_INF("ESB PRX up: ch %d, beacons every %d ms",
		HTK_RF_CHANNEL, HTK_BEACON_PERIOD_MS);
	return 0;
}
```

## src/radio.h
```c
/* ESB broadcast fabric, dongle side: PRX on the uplink address for tracker
 * data, periodic PTX beacons on the downlink address for presence + command
 * carriage (PROTOCOL.md Part 2).
 * SPDX-License-Identifier: GPL-3.0-or-later */
#ifndef APP_RADIO_H
#define APP_RADIO_H

#include <stddef.h>
#include <stdint.h>

/* Starts HF clock, ESB PRX on the uplink address, the RX processing thread's
 * feed, and the beacon timer. */
int radio_init(void);

/* Load a sensor-directed command payload (type + body, as received from the
 * host) into the pending beacon slot. It is embedded verbatim in the next
 * HTK_BEACON_CMD_REPEATS beacons, then cleared. Only the latest command is
 * kept (last-writer-wins, per PROTOCOL.md §2.3). Safe from any context. */
void radio_set_pending_cmd(const uint8_t *payload, size_t len);

/* Bring-up diagnostics: beacon TX outcome counters (cumulative). */
struct radio_beacon_stats {
	uint32_t attempts;    /* beacon work executions */
	uint32_t sent;        /* TX_SUCCESS confirmed */
	uint32_t setup_fail;  /* PTX reconfigure failed */
	uint32_t write_fail;  /* esb_write_payload != 0 */
	uint32_t tx_timeout;  /* no TX event within 10 ms */
	uint32_t prx_fail;    /* PRX restore failed */
};
void radio_get_beacon_stats(struct radio_beacon_stats *out);

#endif
```

## src/sim.c
```c
/* SPDX-License-Identifier: GPL-3.0-or-later
 *
 * Simulator (F5): synthetic ORIENT stream as tracker HTK_ID_SIM at 208 Hz,
 * slow yaw sweep about world Z. Runs alongside real trackers; the SIM flag
 * and reserved id keep it unmistakable on the host side. Float math happens
 * in the system workqueue, not in the timer ISR.
 */
#include <zephyr/kernel.h>
#include <math.h>
#include <stdbool.h>

#include <htk_protocol.h>

#include "sim.h"
#include "usb_io.h"

#define SIM_RATE_HZ        208
#define SIM_PERIOD_US      (1000000 / SIM_RATE_HZ) /* ~4807 us */
#define SIM_YAW_RATE_DPS   10.0f
#define DEG_TO_RAD         0.017453293f
#define TWO_PI             6.283185307f

static bool active;
static uint16_t seq;      /* monotonic across enable/disable cycles */
static float yaw_rad;

static void sim_work_fn(struct k_work *work)
{
	ARG_UNUSED(work);

	yaw_rad += (SIM_YAW_RATE_DPS * DEG_TO_RAD) / (float)SIM_RATE_HZ;
	if (yaw_rad > TWO_PI) {
		yaw_rad -= TWO_PI;
	}

	/* Rotation about world Z (yaw): q = {cos(a/2), 0, 0, sin(a/2)}. */
	const struct htk_orient o = {
		.type = HTK_PKT_ORIENT,
		.id = HTK_ID_SIM,
		.seq = seq++,
		.t_us = (uint32_t)k_ticks_to_us_floor64(k_uptime_ticks()),
		.q_w = cosf(yaw_rad * 0.5f),
		.q_x = 0.0f,
		.q_y = 0.0f,
		.q_z = sinf(yaw_rad * 0.5f),
		.flags = HTK_ORIENT_SIM,
	};

	usb_io_send_payload(&o, sizeof(o));
}
static K_WORK_DEFINE(sim_work, sim_work_fn);

static void sim_timer_fn(struct k_timer *timer)
{
	ARG_UNUSED(timer);
	k_work_submit(&sim_work);
}
static K_TIMER_DEFINE(sim_timer, sim_timer_fn, NULL);

void sim_set(bool on)
{
	if (on == active) {
		return;
	}
	active = on;
	if (on) {
		k_timer_start(&sim_timer, K_USEC(SIM_PERIOD_US),
			      K_USEC(SIM_PERIOD_US));
	} else {
		k_timer_stop(&sim_timer);
	}
}

bool sim_is_active(void)
{
	return active;
}
```

## src/sim.h
```c
/* Simulator: 208 Hz synthetic ORIENT stream as tracker HTK_ID_SIM, so the
 * whole host path can be exercised with no head unit or radio link (F5).
 * SPDX-License-Identifier: GPL-3.0-or-later */
#ifndef APP_SIM_H
#define APP_SIM_H

#include <stdbool.h>

void sim_set(bool on);
bool sim_is_active(void);

#endif
```

## src/trackers.c
```c
/* SPDX-License-Identifier: GPL-3.0-or-later
 *
 * Tracker table (PROTOCOL.md §1.4/§2.5): fixed 8 slots keyed by tracker id.
 * Loss/rate numbers are as observed by THIS dongle — every receiver keeps
 * its own. Called from the radio processing thread (updates) and from the
 * system workqueue (1 Hz tick, GET_STATS); a spinlock guards the table and
 * frame encoding happens outside it on a snapshot.
 */
#include <zephyr/kernel.h>
#include <zephyr/logging/log.h>
#include <string.h>

#include <htk_protocol.h>

#include "trackers.h"
#include "usb_io.h"
#include "sim.h"

LOG_MODULE_REGISTER(trackers, CONFIG_LOG_DEFAULT_LEVEL);

#define LIVE_WINDOW_MS   3000   /* STATUS.n_trackers: seen within 3 s */
#define LINK_UP_MS       500    /* TRACKER_STAT LINK_UP flag */
#define EVICT_SILENT_MS  30000  /* drop from table after 30 s silence */

struct tracker {
	bool     valid;
	bool     have_seq;      /* last_seq meaningful (first packet seen) */
	uint16_t id;
	int64_t  last_seen;     /* k_uptime_get() at last packet */
	uint16_t last_seq;
	uint32_t seq_lost;      /* cumulative since dongle boot */
	uint16_t pkt_count;     /* ORIENT/RAW in the current second */
	uint16_t rate;          /* previous second's pkt_count */
	uint16_t vbat_mV;       /* self-reported; 0 = unknown */
	uint8_t  fw[3];         /* self-reported */
	uint8_t  mode;          /* self-reported HTK_MODE_* */
};

static struct tracker table[TRACKERS_MAX];
static struct k_spinlock lock;

/* All air packets (ORIENT + RAW + TSTATUS) for STATUS.rx_rate. */
static uint32_t rx_count_this_second;
static uint16_t rx_rate;

/* Must be called under `lock`. Returns NULL when the table is full of
 * recently-active trackers (the stream is still forwarded to USB; the
 * tracker just goes unaccounted until a slot frees — beyond-spec load). */
static struct tracker *claim(uint16_t id, int64_t now)
{
	struct tracker *free_slot = NULL;
	struct tracker *stale = NULL;

	for (int i = 0; i < TRACKERS_MAX; i++) {
		struct tracker *t = &table[i];

		if (t->valid && t->id == id) {
			return t;
		}
		if (!t->valid) {
			if (free_slot == NULL) {
				free_slot = t;
			}
		} else if ((now - t->last_seen) > EVICT_SILENT_MS &&
			   stale == NULL) {
			stale = t;
		}
	}

	struct tracker *slot = (free_slot != NULL) ? free_slot : stale;

	if (slot != NULL) {
		memset(slot, 0, sizeof(*slot));
		slot->valid = true;
		slot->id = id;
	}
	return slot;
}

void trackers_on_sample(uint16_t id, uint16_t seq)
{
	int64_t now = k_uptime_get();

	K_SPINLOCK(&lock) {
		rx_count_this_second++;

		struct tracker *t = claim(id, now);

		if (t == NULL) {
			K_SPINLOCK_BREAK;
		}
		t->last_seen = now;
		if (t->pkt_count < UINT16_MAX) {
			t->pkt_count++;
		}

		if (!t->have_seq) {
			t->have_seq = true;
			t->last_seq = seq;
		} else {
			/* Gap accounting modulo 2^16 (§2.5). step==1 is the
			 * normal case; a gap of n adds n-1. No retransmits
			 * exist, so step==0 (duplicate) or step>0x8000
			 * (stale/reordered) should not happen — guard anyway
			 * and leave last_seq at the newer value. */
			uint16_t step = (uint16_t)(seq - t->last_seq);

			if (step != 0 && step <= 0x8000u) {
				t->seq_lost += step - 1u;
				t->last_seq = seq;
			}
		}
	}
}

void trackers_on_tstatus(const struct htk_tstatus *ts)
{
	int64_t now = k_uptime_get();

	K_SPINLOCK(&lock) {
		rx_count_this_second++;

		struct tracker *t = claim(ts->id, now);

		if (t == NULL) {
			K_SPINLOCK_BREAK;
		}
		t->last_seen = now;
		t->vbat_mV = ts->vbat_mV;
		t->fw[0] = ts->fw_major;
		t->fw[1] = ts->fw_minor;
		t->fw[2] = ts->fw_patch;
		t->mode = ts->mode;
	}
}

/* Snapshot + emit, encoding outside the lock. */
static void emit_locked_snapshot(void)
{
	struct tracker snap[TRACKERS_MAX];
	uint16_t rate_snap;
	int64_t now = k_uptime_get();

	K_SPINLOCK(&lock) {
		memcpy(snap, table, sizeof(snap));
		rate_snap = rx_rate;
	}

	uint8_t n_live = 0;

	for (int i = 0; i < TRACKERS_MAX; i++) {
		if (snap[i].valid && (now - snap[i].last_seen) < LIVE_WINDOW_MS) {
			n_live++;
		}
	}

	const struct htk_status status = {
		.type = HTK_PKT_STATUS,
		.uptime_ms = (uint32_t)k_uptime_get(),
		.rx_rate = rate_snap,
		.n_trackers = n_live,
		.flags = sim_is_active() ? HTK_STATUS_SIM_ACTIVE : 0,
	};
	usb_io_send_payload(&status, sizeof(status));

	for (int i = 0; i < TRACKERS_MAX; i++) {
		const struct tracker *t = &snap[i];

		if (!t->valid) {
			continue;
		}
		int64_t age = now - t->last_seen;
		const struct htk_tracker_stat stat = {
			.type = HTK_PKT_TRACKER_STAT,
			.id = t->id,
			.age_ms = (age < 0) ? 0 : (uint32_t)age,
			.rate = t->rate,
			.seq_lost = t->seq_lost,
			.vbat_mV = t->vbat_mV,
			.fw_major = t->fw[0],
			.fw_minor = t->fw[1],
			.fw_patch = t->fw[2],
			.mode = t->mode,
			.flags = (age < LINK_UP_MS) ? HTK_TSTAT_LINK_UP : 0,
		};
		usb_io_send_payload(&stat, sizeof(stat));
	}
}

void trackers_tick_1hz(void)
{
	int64_t now = k_uptime_get();

	K_SPINLOCK(&lock) {
		rx_rate = (rx_count_this_second > UINT16_MAX)
			  ? UINT16_MAX : (uint16_t)rx_count_this_second;
		rx_count_this_second = 0;

		for (int i = 0; i < TRACKERS_MAX; i++) {
			struct tracker *t = &table[i];

			if (!t->valid) {
				continue;
			}
			t->rate = t->pkt_count;
			t->pkt_count = 0;
			if ((now - t->last_seen) > EVICT_SILENT_MS) {
				t->valid = false;
			}
		}
	}

	emit_locked_snapshot();
}

void trackers_emit_stats(void)
{
	emit_locked_snapshot();
}
```

## src/trackers.h
```c
/* Tracker table: per-id sequence/loss/rate accounting and the 1 Hz
 * STATUS + TRACKER_STAT emission (PROTOCOL.md §1.4, §2.5).
 * SPDX-License-Identifier: GPL-3.0-or-later */
#ifndef APP_TRACKERS_H
#define APP_TRACKERS_H

#include <stdint.h>

struct htk_tstatus;

#define TRACKERS_MAX 8

/* One ORIENT/RAW sample arrived from tracker `id` (radio thread). Updates
 * last-seen, per-second rate, and seq-gap loss accounting. */
void trackers_on_sample(uint16_t id, uint16_t seq);

/* A 1 Hz TSTATUS self-report arrived (radio thread). */
void trackers_on_tstatus(const struct htk_tstatus *ts);

/* Call exactly once per second: folds per-second counters into rates,
 * evicts trackers silent > 30 s, then emits STATUS + TRACKER_STATs. */
void trackers_tick_1hz(void);

/* Emit STATUS + one TRACKER_STAT per valid tracker now (GET_STATS path).
 * Uses the rates computed at the last 1 Hz tick; does not reset counters. */
void trackers_emit_stats(void);

#endif
```

## src/usb_io.c
```c
/* SPDX-License-Identifier: GPL-3.0-or-later
 *
 * CDC-ACM host pipe.
 *
 * TX: complete encoded frames only, stored length-prefixed in a ring buffer;
 * the interrupt path drains ONE frame per tx-ready callback so no partial
 * frame is ever interleaved and every fill batch ends with the frame's 0x00
 * terminator (PRD risk 2: Windows CDC read latency — the host parser must
 * never wait across a 64-byte boundary for a frame end).
 *
 * RX: bytes accumulate and are split on 0x00 delimiters; each block is
 * htk_frame_decode()d and dispatched. Unknown types are ignored (forward
 * compatibility, PROTOCOL.md §1.3).
 */
#include <zephyr/kernel.h>
#include <zephyr/device.h>
#include <zephyr/drivers/uart.h>
#include <zephyr/usb/usb_device.h>
#include <zephyr/sys/ring_buffer.h>
#include <zephyr/sys/byteorder.h>
#include <zephyr/logging/log.h>

#include <htk_protocol.h>
#include <htk_frame.h>

#include "usb_io.h"
#include "trackers.h"
#include "radio.h"
#include "sim.h"

LOG_MODULE_REGISTER(usb_io, CONFIG_LOG_DEFAULT_LEVEL);

static const struct device *const cdc_dev =
	DEVICE_DT_GET(DT_NODELABEL(cdc_acm_uart0));

static volatile bool usb_configured;

/* ---- TX: frame ring ----------------------------------------------------
 * Entries are [len:u8][frame bytes]; a frame is enqueued only if it fits
 * whole, else dropped. ~2 KB absorbs ~35 ORIENT frames (~170 ms of one
 * tracker at 208 Hz) across host scheduling hiccups. The lock spans the
 * two-part put/get so the consumer can never observe a length prefix
 * without its frame bytes. */
RING_BUF_DECLARE(tx_ring, 2048);
static struct k_spinlock tx_lock;
static uint32_t tx_dropped;

/* In-flight frame, consumer (irq callback) context only. */
static uint8_t tx_cur[HTK_MAX_FRAME];
static uint8_t tx_cur_len;
static uint8_t tx_cur_off;

/* ---- RX: byte ring (ISR producer) -> work (parser consumer) ------------ */
RING_BUF_DECLARE(rx_ring, 256);
static uint8_t rx_block[HTK_MAX_FRAME]; /* work context only */
static size_t  rx_block_len;
static bool    rx_block_overflow;
static uint32_t rx_bad_frames;

static void rx_work_fn(struct k_work *work);
static K_WORK_DEFINE(rx_work, rx_work_fn);

/* ---- host -> dongle dispatch (work context) ---------------------------- */

static void send_hello_resp(void)
{
	const struct htk_hello_resp resp = {
		.type = HTK_PKT_HELLO_RESP,
		.proto_ver = HTK_PROTO_VERSION,
		.fw_major = HTK_FW_MAJOR,
		.fw_minor = HTK_FW_MINOR,
		.fw_patch = HTK_FW_PATCH,
		.device = 1, /* dongle */
		.caps = HTK_CAP_QUAT | HTK_CAP_RAW | HTK_CAP_SIM | HTK_CAP_MULTI,
	};

	usb_io_send_payload(&resp, sizeof(resp));
}

static void dispatch_payload(const uint8_t *p, size_t len)
{
	switch (p[0]) {
	case HTK_PKT_HELLO:
		if (len == sizeof(struct htk_hello)) {
			/* Version check is the host's job (§1.7); always answer. */
			send_hello_resp();
		}
		break;

	case HTK_PKT_GET_STATS:
		if (len == sizeof(struct htk_get_stats)) {
			trackers_emit_stats();
		}
		break;

	case HTK_PKT_SIM_MODE:
		if (len == sizeof(struct htk_sim_mode)) {
			sim_set(p[1] != 0);
		}
		break;

	/* Sensor-directed commands: validate target id, then hand the payload
	 * verbatim to the beacon pending slot. Invalid ids are silently
	 * dropped ("rejected", §1.5). */
	case HTK_PKT_RESET_FUSION:
	case HTK_PKT_IDENTIFY:
	case HTK_PKT_SET_RATE:
	case HTK_PKT_SET_MODE: {
		size_t want = (p[0] == HTK_PKT_SET_RATE) ? sizeof(struct htk_set_rate)
			    : (p[0] == HTK_PKT_SET_MODE) ? sizeof(struct htk_set_mode)
			    : sizeof(struct htk_cmd_id);
		if (len != want) {
			break;
		}
		uint16_t id = sys_get_le16(&p[1]);

		if (id == HTK_ID_INVALID || id == HTK_ID_SIM) {
			break;
		}
		radio_set_pending_cmd(p, len);
		break;
	}

	default:
		/* Unknown type: skip without error (forward compatibility). */
		break;
	}
}

static void rx_work_fn(struct k_work *work)
{
	ARG_UNUSED(work);
	uint8_t b;

	while (ring_buf_get(&rx_ring, &b, 1) == 1) {
		if (b != 0x00) {
			if (rx_block_len < sizeof(rx_block)) {
				rx_block[rx_block_len++] = b;
			} else {
				/* Oversized: discard until next delimiter. */
				rx_block_overflow = true;
			}
			continue;
		}
		if (rx_block_len > 0 && !rx_block_overflow) {
			uint8_t payload[HTK_MAX_PAYLOAD];
			size_t n = htk_frame_decode(rx_block, rx_block_len,
						    payload, sizeof(payload));
			if (n > 0) {
				dispatch_payload(payload, n);
			} else {
				rx_bad_frames++;
			}
		}
		rx_block_len = 0;
		rx_block_overflow = false;
	}
}

/* ---- UART interrupt path ----------------------------------------------- */

static void cdc_irq_handler(const struct device *dev, void *user_data)
{
	ARG_UNUSED(user_data);

	while (uart_irq_update(dev) && uart_irq_is_pending(dev)) {
		if (uart_irq_rx_ready(dev)) {
			uint8_t buf[64];
			int n = uart_fifo_read(dev, buf, sizeof(buf));

			if (n > 0) {
				/* Partial put on overflow is fine: the parser
				 * resynchronizes on the next 0x00. */
				ring_buf_put(&rx_ring, buf, n);
				k_work_submit(&rx_work);
			}
		}

		if (uart_irq_tx_ready(dev)) {
			if (tx_cur_off == tx_cur_len) {
				/* Fetch next frame ([len][bytes]) atomically. */
				k_spinlock_key_t key = k_spin_lock(&tx_lock);
				uint8_t len;

				if (ring_buf_get(&tx_ring, &len, 1) != 1) {
					k_spin_unlock(&tx_lock, key);
					uart_irq_tx_disable(dev);
					continue;
				}
				ring_buf_get(&tx_ring, tx_cur, len);
				k_spin_unlock(&tx_lock, key);
				tx_cur_len = len;
				tx_cur_off = 0;
			}

			int n = uart_fifo_fill(dev, &tx_cur[tx_cur_off],
					       tx_cur_len - tx_cur_off);
			if (n > 0) {
				tx_cur_off += n;
			}
			/* ONE frame per fill batch: once this frame is fully
			 * accepted (its 0x00 included), stop; the next
			 * tx-ready callback sends the next frame. If the CDC
			 * buffer stalled mid-frame, also stop — the remainder
			 * goes first on the next callback, so frames are never
			 * interleaved.
			 * VERIFY on hardware: with the legacy stack the CDC
			 * ring may still coalesce two small frames into one
			 * 64 B IN transfer; harmless (both are complete and
			 * 0x00-terminated, so the host parser never stalls),
			 * but confirm no partial-frame tail ever ends a
			 * transfer. The planned usbd migration gives per-
			 * transfer control. */
			break;
		}
	}
}

/* ---- API ---------------------------------------------------------------- */

void usb_io_send_payload(const void *payload, size_t len)
{
	uint8_t frame[HTK_MAX_FRAME];
	size_t flen = htk_frame_encode(payload, len, frame, sizeof(frame));

	if (flen == 0) {
		return;
	}
	if (!usb_configured) {
		/* No host: don't age frames in the ring. */
		return;
	}

	k_spinlock_key_t key = k_spin_lock(&tx_lock);

	if (ring_buf_space_get(&tx_ring) >= flen + 1) {
		uint8_t l = (uint8_t)flen;

		ring_buf_put(&tx_ring, &l, 1);
		ring_buf_put(&tx_ring, frame, flen);
		k_spin_unlock(&tx_lock, key);
		uart_irq_tx_enable(cdc_dev);
	} else {
		/* Never block the radio path on a slow host: drop + count. */
		tx_dropped++;
		k_spin_unlock(&tx_lock, key);
		if ((tx_dropped & 0x3FFu) == 1) {
			LOG_WRN("TX ring full, %u frames dropped", tx_dropped);
		}
	}
}

uint32_t usb_io_tx_dropped(void)
{
	return tx_dropped;
}

bool usb_io_is_configured(void)
{
	return usb_configured;
}

static void usb_status_cb(enum usb_dc_status_code status, const uint8_t *param)
{
	ARG_UNUSED(param);

	switch (status) {
	case USB_DC_CONFIGURED:
		usb_configured = true;
		break;
	case USB_DC_DISCONNECTED:
	case USB_DC_SUSPEND:
	case USB_DC_RESET:
		usb_configured = false;
		break;
	default:
		break;
	}
}

int usb_io_init(void)
{
	if (!device_is_ready(cdc_dev)) {
		return -ENODEV;
	}

	/* Status callback instead of usb_enable(NULL): the configured flag
	 * gates TX and drives the blue heartbeat. */
	int err = usb_enable(usb_status_cb);

	if (err) {
		return err;
	}

	uart_irq_callback_set(cdc_dev, cdc_irq_handler);
	uart_irq_rx_enable(cdc_dev);
	return 0;
}
```

## src/usb_io.h
```c
/* CDC-ACM host pipe: COBS framing both directions, TX frame ring, host
 * command dispatch.
 * SPDX-License-Identifier: GPL-3.0-or-later */
#ifndef APP_USB_IO_H
#define APP_USB_IO_H

#include <stdbool.h>
#include <stddef.h>
#include <stdint.h>

/* Binds the CDC UART, registers IRQ callbacks, and calls usb_enable(). */
int usb_io_init(void);

bool usb_io_is_configured(void);

/* Encode one USB payload (type + body) into a frame and queue it for the
 * host. Never blocks: if the TX ring cannot take the whole frame, the frame
 * is dropped and counted. Safe from any thread; not for ISR use (the radio
 * path calls it from its processing thread, never from the ESB IRQ). */
void usb_io_send_payload(const void *payload, size_t len);

/* Frames dropped because the TX ring was full (host slow/absent). */
uint32_t usb_io_tx_dropped(void);

#endif
```
